#include <behaviors.dtsi>
#include <dt-bindings/zmk/keys.h>
#include <dt-bindings/zmk/bt.h>
#include <dt-bindings/zmk/outputs.h>
#include <dt-bindings/zmk/mouse.h>
#include <dt-bindings/zmk/ext_power.h>

#include "constants.h"
#define HOST_OS LINUX // Needed for unicode international_chars

#include "../zmk-nodefree-config/helper.h"
#include "../chars/math.dtsi"
#include "../chars/typography.dtsi"
#include "../layouts/col_main.dtsi"
#include "../behaviors/combos_36.dtsi"
#include "../behaviors/hold-tap.dtsi"
#include "../behaviors/macros.dtsi"
#include "../behaviors/mod-morph.dtsi"
#include "../behaviors/mouse.dtsi"

ZMK_LAYER_5COL(Colemak,
// ╭───────────┬───────────┬───────────┬────────────┬────────────╮ ╭───────────┬─────────────┬─────────────┬────────────┬────────────╮
     &kp Q       &kp W       &kp F       &kp P        &kp B          &kp J       &kp L         &kp U         &kp Y        &kp SQT
// ├───────────┼───────────┼───────────┼────────────┼────────────┤ ├───────────┼─────────────┼─────────────┼────────────┼────────────┤
     &kp  A   &hml AL R   &hml CL S   &hml SL T    &kp G          &kp M       &hmr SR N     &hmr CL E     &hmr AR I       &kp O
// ├───────────┼───────────┼───────────┼────────────┼────────────┤ ├───────────┼─────────────┼─────────────┼────────────┼────────────┤
     &kp Z       &kp X       &kp C       &kp D        &kp V          &kp K       &kp H         &kp COMMA     &kp DOT      &kp FSLH
// ╰───────────┴───────────┼───────────┼────────────┼────────────┤ ├───────────┼─────────────┼─────────────┼────────────┴────────────╯
                            XXX  &smart_shft &lt NUM RETURN  &lt NAV  SPACE  &mo SYM        XXX   
//                         ╰───────────┴────────────┴────────────╯ ╰───────────┴─────────────┴─────────────╯
) 

ZMK_LAYER_5COL(Symbols,
// ╭───────────┬───────────┬───────────┬────────────┬────────────╮ ╭───────────┬─────────────┬─────────────┬────────────┬────────────╮
     &kp LBKT   &kp RBKT      &kp COLON       &kp PIPE        XXX          &kp  TILDE  &kp AMPS      &kp STAR       &kp LPAR     &kp PLUS
// ├───────────┼───────────┼───────────┼────────────┼────────────┤ ├───────────┼─────────────┼─────────────┼────────────┼────────────┤
     &kp LBRC   &kp  LBRC  &kp UNDER     &kp SEMI     &kp EQUAL              &kp GRAVE    &kp DLLR      &kp  PRCNT     &kp CARET         &kp RPAR
// ├───────────┼───────────┼───────────┼────────────┼────────────┤ ├───────────┼─────────────┼─────────────┼────────────┼────────────┤
     &kp LT      &kp  GT     XXX        &kp DQT         &kp BSLH            XXX    &kp EXCL      &kp AT         &kp HASH     &kp MINUS
// ╰───────────┴───────────┼───────────┼────────────┼────────────┤ ├───────────┼─────────────┼─────────────┼────────────┴────────────╯
                             ___         ___          ___            ___         ___           ___
//                         ╰───────────┴────────────┴────────────╯ ╰───────────┴─────────────┴─────────────╯
)  

// screenshot, caps lock, chinese

ZMK_LAYER_5COL(Nav,
// ╭───────────┬───────────┬───────────┬────────────┬────────────╮ ╭───────────┬─────────────┬─────────────┬────────────┬────────────╮
      &mkp_rg     &mkp_md      &mkp_lf      &msc_up     &msc_dn       &mkp_lf       &alt_left    &alt_down     &alt_up      &alt_right 
// ├───────────┼───────────┼───────────┼────────────┼───────────┤ ├───────────┼─────────────┼─────────────┼────────────┼────────────┤
    &mmv_lf     &mmv_dn       &mmv_up     &mmv_rg   &kp PG_UP       &kp HOME      &kp LEFT        &kp DOWN      &kp UP     &kp RIGHT
// ├───────────┼───────────┼───────────┼────────────┼────────────┤ ├───────────┼─────────────┼─────────────┼────────────┼────────────┤
&ctrl_alt_left &ctrl_alt_down &ctrl_alt_up &ctrl_alt_right &kp PG_DN &kp END       &ctrl_left   &ctrl_down    &ctrl_up     &ctrl_right
// ╰───────────┴───────────┼───────────┼────────────┼────────────┤ ├───────────┼─────────────┼─────────────┼────────────┴────────────╯
                              XXX       &kp SL     &mo BETTER_NAV     &kp TAB          ___           ___
//                         ╰───────────┴────────────┴────────────╯ ╰───────────┴─────────────┴─────────────╯
)


ZMK_LAYER_5COL(Numbers,
// ╭───────────┬───────────┬───────────┬────────────┬────────────╮ ╭───────────┬─────────────┬─────────────┬────────────┬────────────╮
     XXX         &chinese   &kp CAPSLOCK  &ctrl_bspc   &kp BSPC      &kp DEL      &kp N7        &kp N8        &kp N9       &kp PLUS
// ├───────────┼───────────┼───────────┼────────────┼────────────┤ ├───────────┼─────────────┼─────────────┼────────────┼────────────┤
     &kp GL      &kp AL      &kp CL      &kp SL       XXX            &kp DOT     &kp N4        &kp N5        &kp N6       &kp N0
// ├───────────┼───────────┼───────────┼────────────┼────────────┤ ├───────────┼─────────────┼─────────────┼────────────┼────────────┤
 XXX          XXX         XXX         &kp K_CONTEXT_MENU              XXX               &kp INS    &kp N1        &kp N2        &kp N3       &kp MINUS
// ╰───────────┴───────────┼───────────┼────────────┼────────────┤ ├───────────┼─────────────┼─────────────┼────────────┴────────────╯
                             ___         ___          ___            &mo FUNC        &mo SWITCH        XXX
//                         ╰───────────┴────────────┴────────────╯ ╰───────────┴─────────────┴─────────────╯
)


ZMK_LAYER_5COL(Func,
// ╭───────────┬───────────┬───────────┬────────────┬────────────╮ ╭───────────┬─────────────┬─────────────┬────────────┬────────────╮
     &kp F7      &kp F8      &kp F9      &kp F10       &kp F13        &kp C_PP    &kp C_PREV    &kp C_VOL_DN  &kp C_VOL_UP &kp C_NEXT     
// ├───────────┼───────────┼───────────┼────────────┼────────────┤ ├───────────┼─────────────┼─────────────┼────────────┼────────────┤
     &kp F4      &kp F5      &kp F6      &kp F11       &kp F14        XXX         &kp SL        &kp CL        &kp AL       &kp GL
// ├───────────┼───────────┼───────────┼────────────┼────────────┤ ├───────────┼─────────────┼─────────────┼────────────┼────────────┤
     &kp F1     &kp F2       &kp F3     &kp F12        &kp F15        &out OUT_TOG &bt BT_PRV   &ext_power EP_ON  &ext_power EP_TOG &bt BT_NXT  
// ╰───────────┴───────────┼───────────┼────────────┼────────────┤ ├───────────┼─────────────┼─────────────┼────────────┴────────────╯
                             XXX         &kp GL        XXX             ___     &bt BT_CLR ___
//                         ╰───────────┴────────────┴────────────╯ ╰───────────┴─────────────┴─────────────╯
)


ZMK_LAYER_5COL(Switch,
// ╭───────────┬───────────┬───────────┬────────────┬────────────╮ ╭───────────┬─────────────┬─────────────┬────────────┬────────────╮
     &lock       &gui_7      &gui_8      &gui_9        XXX            &kp INS     &ctrl_7      &ctrl_8       &ctrl_9       &kp PLUS
// ├───────────┼───────────┼───────────┼────────────┼────────────┤ ├───────────┼─────────────┼─────────────┼────────────┼────────────┤
     XXX         &gui_4      &gui_5      &gui_6      &kp SL           &kp DOT     &ctrl_4       &ctrl_5         &ctrl_6        &ctrl_0
// ├───────────┼───────────┼───────────┼────────────┼────────────┤ ├───────────┼─────────────┼─────────────┼────────────┼────────────┤
     XXX        &gui_1      &gui_2      &gui_3     XXX               &kp DEL     &ctrl_1       &ctrl_2      &ctrl_3       &kp MINUS
// ╰───────────┴───────────┼───────────┼────────────┼────────────┤ ├───────────┼─────────────┼─────────────┼────────────┴────────────╯
                             ___         ___          ___            &kp CL         &kp GL       XXX 
//                         ╰───────────┴────────────┴────────────╯ ╰───────────┴─────────────┴─────────────╯
)


ZMK_LAYER_5COL(Alt_switch,
// ╭───────────┬───────────┬───────────┬────────────┬────────────╮ ╭───────────┬─────────────┬─────────────┬────────────┬────────────╮
 &lock_win    &clsl_7      &clsl_8      &clsl_9        XXX                 XXX         &alt_7        &alt_8      &alt_9        XXX            
// ├───────────┼───────────┼───────────┼────────────┼────────────┤ ├───────────┼─────────────┼─────────────┼────────────┼────────────┤
     XXX         &clsl_4      &clsl_5      &clsl_6      &clsl_0              XXX         &alt_4      &alt_5      &alt_6      &alt_0          
// ├───────────┼───────────┼───────────┼────────────┼────────────┤ ├───────────┼─────────────┼─────────────┼────────────┼────────────┤
     XXX        &clsl_1      &clsl_2      &clsl_3     XXX                  XXX        &alt_1      &alt_2      &alt_3     XXX              
// ╰───────────┴───────────┼───────────┼────────────┼────────────┤ ├───────────┼─────────────┼─────────────┼────────────┴────────────╯
                             ___         ___          ___            &kp CL         &kp GL        XXX
//                         ╰───────────┴────────────┴────────────╯ ╰───────────┴─────────────┴─────────────╯
)


ZMK_LAYER_5COL(Book_switch,
// ╭───────────┬───────────┬───────────┬────────────┬────────────╮ ╭───────────┬─────────────┬─────────────┬────────────┬────────────╮
     &lock_win    &clsl_7      &clsl_8      &clsl_9        XXX               XXX        XXX         XXX          XXX          XXX
// ├───────────┼───────────┼───────────┼────────────┼────────────┤ ├───────────┼─────────────┼─────────────┼────────────┼────────────┤
     XXX         &clsl_4      &clsl_5      &clsl_6      &clsl_0              XXX        XXX          XXX            XXX           XXX
// ├───────────┼───────────┼───────────┼────────────┼────────────┤ ├───────────┼─────────────┼─────────────┼────────────┼────────────┤
     XXX        &clsl_1      &clsl_2      &clsl_3     XXX                  XXX        XXX          XXX         XXX          XXX
// ╰───────────┴───────────┼───────────┼────────────┼────────────┤ ├───────────┼─────────────┼─────────────┼────────────┴────────────╯
                             ___         ___          ___               XXX            XXX       XXX 
//                         ╰───────────┴────────────┴────────────╯ ╰───────────┴─────────────┴─────────────╯
)


ZMK_LAYER_5COL(Better_nav,
// ╭───────────┬───────────┬───────────┬────────────┬────────────╮ ╭───────────┬─────────────┬─────────────┬────────────┬────────────╮
    &mkp_rg     &mkp_md      &mkp_lf    &fmsc_up     &fmsc_dn       &mkp_lf      &fmsc_lf            &cl_mkp_lf   &al_mkp_lf           &fmsc_rg     
// ├───────────┼───────────┼───────────┼────────────┼───────────┤ ├───────────┼─────────────┼─────────────┼────────────┼────────────┤
    &fmmv_lf     &fmmv_dn       &fmmv_up     &fmmv_rg   XXX             XXX      &shift_win_LEFT    &shift_win_DOWN      &shift_win_UP     &shift_win_RIGHT
// ├───────────┼───────────┼───────────┼────────────┼────────────┤ ├───────────┼─────────────┼─────────────┼────────────┼────────────┤
     XXX          XXX           XXX         XXX         XXX          XXX          &win_LEFT    &win_DOWN      &win_UP     &win_RIGHT
// ╰───────────┴───────────┼───────────┼────────────┼────────────┤ ├───────────┼─────────────┼─────────────┼────────────┴────────────╯
                             XXX            XXX         XXX             XXX         XXX           XXX
//                         ╰───────────┴────────────┴────────────╯ ╰───────────┴─────────────┴─────────────╯
)

