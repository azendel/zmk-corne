#include <behaviors.dtsi>
#include <dt-bindings/zmk/keys.h>
#include "../zmk-nodefree-config/helper.h"
#include "../zmk-nodefree-config/keypos_def/keypos_36keys.h"
#include "./combos.dtsi"
#include "../config/constants.h"

#pragma once

// NOTE: Only thumb keys are different between 34/36 layouts
//       All other combos should be in ./combos.dtsi

/***********************
  THUMBS
***********************/

// TAB - Inner right thumbs, active on all alpha layers
ZMK_COMBO(tab, &kp TAB, RH0 LH0 , COL )
     
       
        
   
         
                    
