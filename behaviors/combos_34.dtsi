#include <behaviors.dtsi>
#include <dt-bindings/zmk/keys.h>
#include "../zmk-nodefree-config/helper.h"
#include "../zmk-nodefree-config/keypos_def/keypos_34keys.h"
#include "./combos.dtsi"
#include "../config/constants.h"

#pragma once

// NOTE: Only thumb keys are different between 34/36 layouts
//       All other combos should be in ./combos.dtsi

/***********************
  THUMBS
***********************/

// TAB - Right thumbs, active on all alpha layers
ZMK_COMBO(tab_34, &kp TAB, RH0 RH2, COL)


