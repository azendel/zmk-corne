#include <behaviors.dtsi>
#include <dt-bindings/zmk/mouse.h>
#include <dt-bindings/zmk/keys.h>
#include "../zmk-nodefree-config/helper.h"
#include "../zmk-nodefree-config/keypos_def/keypos_36keys.h"
#include "../config/constants.h"

// Documentation : https://deploy-preview-778--zmk.netlify.app/docs/behaviors/mouse-emulation/
// Codes : https://github.com/zmkfirmware/zmk/blob/ee855f4d6736da4d696e74f7875d209c7c173a11/app/include/dt-bindings/zmk/mouse.h

&mmv {
    acceleration-exponent=<1>;
    delay-ms=<10>;
    time-to-max-speed-ms = <200>;
};

&msc {
    acceleration-exponent=<2>;
    delay-ms=<0>;
    time-to-max-speed-ms = <100>;
};

#define MOUSE_SCRL_VAL 15
#define MOUSE_MOVE_VAL 1200


#define MOVE_UP MOVE_Y(-MOUSE_MOVE_VAL)
#define MOVE_DOWN MOVE_Y(MOUSE_MOVE_VAL)
#define MOVE_LEFT MOVE_X(-MOUSE_MOVE_VAL)
#define MOVE_RIGHT MOVE_X(MOUSE_MOVE_VAL)

#define SCRL_UP MOVE_Y(MOUSE_SCRL_VAL)
#define SCRL_DOWN MOVE_Y(-MOUSE_SCRL_VAL)
#define SCRL_LEFT MOVE_X(-MOUSE_SCRL_VAL)
#define SCRL_RIGHT MOVE_X(MOUSE_SCRL_VAL)


// Move cursor
#define mmv_up mmv MOVE_UP
#define mmv_dn mmv MOVE_DOWN
#define mmv_lf mmv MOVE_LEFT
#define mmv_rg mmv MOVE_RIGHT

// Mouse buttons
#define mkp_lf mkp LCLK
#define mkp_md mkp MCLK
#define mkp_rg mkp RCLK

// Scroll wheel
#define msc_up msc SCRL_UP
#define msc_dn msc SCRL_DOWN
#define msc_lf msc SCRL_LEFT
#define msc_rg msc SCRL_RIGHT

// Switch move/scroll on Ploopy Nano by pressing NumLock twice
ZMK_BEHAVIOR(msc_tg, macro, bindings =
  <&macro_tap_time 1>,
  <&macro_wait_time 18>,
  <&kp KP_NUMLOCK &kp KP_NUMLOCK>;
)

// Mouse Left Click - Index and Middle finger of left hand, active on all layers
ZMK_COMBO(leftclick, &mkp LCLK, LT1 LT2, COL)

// Mouse Right Click - Pinky and Ring finger of left hand, active on all layers
ZMK_COMBO(rightclick, &mkp RCLK, LT3 LT4, COL)

// Mouse Scroll Toggle -  Middle and Ring finger of left hand, active on all layers
ZMK_COMBO(scrolltoggle, &msc_tg, LT2 LT3, COL)




ZMK_BEHAVIOR(cl_mkp_lf, macro,
    bindings = <&macro_press &kp CL>,  <&macro_tap &mkp_lf>, <&macro_release &kp CL>;
)

ZMK_BEHAVIOR(al_mkp_lf, macro,
    bindings = <&macro_press &kp AL>,  <&macro_tap &mkp_lf>, <&macro_release &kp AL>;
)


#define FAST_MOUSE_SCRL_VAL 30
#define FAST_MOUSE_MOVE_VAL 2400


#define FMOVE_UP MOVE_Y(-FAST_MOUSE_MOVE_VAL)
#define FMOVE_DOWN MOVE_Y(FAST_MOUSE_MOVE_VAL)
#define FMOVE_LEFT MOVE_X(-FAST_MOUSE_MOVE_VAL)
#define FMOVE_RIGHT MOVE_X(FAST_MOUSE_MOVE_VAL)

#define FSCRL_UP MOVE_Y(FAST_MOUSE_SCRL_VAL)
#define FSCRL_DOWN MOVE_Y(-FAST_MOUSE_SCRL_VAL)
#define FSCRL_LEFT MOVE_X(-FAST_MOUSE_SCRL_VAL)
#define FSCRL_RIGHT MOVE_X(FAST_MOUSE_SCRL_VAL)

// Move cursor
#define fmmv_up mmv FMOVE_UP
#define fmmv_dn mmv FMOVE_DOWN
#define fmmv_lf mmv FMOVE_LEFT
#define fmmv_rg mmv FMOVE_RIGHT

// Scroll wheel
#define fmsc_up msc FSCRL_UP
#define fmsc_dn msc FSCRL_DOWN
#define fmsc_lf msc FSCRL_LEFT
#define fmsc_rg msc FSCRL_RIGHT

