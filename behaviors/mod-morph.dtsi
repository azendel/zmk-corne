#include <behaviors.dtsi>
#include <dt-bindings/zmk/keys.h>
#include "../zmk-nodefree-config/helper.h"
#include "../config/constants.h"
#include "../layouts/col_main.dtsi"


&sk {
    release-after-ms = <2000>;
    quick-release;
};


ZMK_BEHAVIOR(smart_shft, mod_morph,
    bindings = <&sk LSHFT>, <&caps_word>;
    mods = <(MOD_LSFT)>;
)

// reuse basic mod-morph scheme
#define SIMPLE_MORPH(NAME, MOD, BINDING1, BINDING2) \
    ZMK_BEHAVIOR(NAME, mod_morph, \
        mods = <(MOD_L ## MOD|MOD_R ## MOD)>; \
        bindings = <BINDING1>, <BINDING2>; \
    )

// tap: comma | shift + tap: semicolon | ctrl + shift + tap: <
//SIMPLE_MORPH(comma_morph, SFT, &kp COMMA, &comma_inner_morph)
//SIMPLE_MORPH(comma_inner_morph, CTL, &kp SEMICOLON, &kp LESS_THAN)

// tap: dot | shift + tap: colon | ctrl + shift + tap: >
//SIMPLE_MORPH(dot_morph, SFT, &kp DOT, &dot_inner_morph)
//SIMPLE_MORPH(dot_inner_morph, CTL, &kp COLON, &kp GREATER_THAN)




// tap: space | shift + tap: tab | hold: nav layer
//  ZMKr_BEHAVIOR(spc_tab_num, mod_morph,
//    bindings = <&lt NUM SPACE>, <&kp TAB>;
 //   mods = <(MOD_LSFT|MOD_RSFT)>;
// )

