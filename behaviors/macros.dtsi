#include <behaviors.dtsi>
#include <dt-bindings/zmk/keys.h>
#include "../zmk-nodefree-config/helper.h"
#include "../config/constants.h"
#include "../layouts/col_main.dtsi"

#pragma once


// Tmux command: TMUX + ;
ZMK_BEHAVIOR(TMUX_CMD, macro, bindings =
    <&kp TMUX>,
    <&kp LS(SEMI)>;
)

// Tmux new session: TMUX + ; + new -s + SPACE
ZMK_BEHAVIOR(TMUX_SESSION, macro, bindings =
    <&kp TMUX>,
    <&kp LS(SEMI)>,
    <&kp N &kp E &kp W &kp SPACE &kp MINUS &kp S &kp SPACE>;
)


ZMK_BEHAVIOR(ctrl_alt_up, macro,
    bindings =<&macro_press  &kp CL>, <&macro_press  &kp AL>, <&macro_tap &kp UP>,<&macro_release &kp CL>, <&macro_release &kp AL>;
)

ZMK_BEHAVIOR(ctrl_alt_down, macro,
    bindings =<&macro_press  &kp CL>, <&macro_press  &kp AL>, <&macro_tap &kp DOWN>,<&macro_release &kp CL>, <&macro_release &kp AL>;
)

ZMK_BEHAVIOR(ctrl_alt_left, macro,
    bindings =<&macro_press  &kp CL>, <&macro_press  &kp AL>, <&macro_tap &kp LEFT>,<&macro_release &kp CL>, <&macro_release &kp AL>;
)

ZMK_BEHAVIOR(ctrl_alt_right, macro,
    bindings =<&macro_press  &kp CL>, <&macro_press  &kp AL>, <&macro_tap &kp RIGHT>,<&macro_release &kp CL>, <&macro_release &kp AL>;
)


ZMK_BEHAVIOR(ctrl_bspc, macro,
    bindings =<&macro_press  &kp CL>,  <&macro_tap &kp BSPC>,<&macro_release &kp CL> ;
)


ZMK_BEHAVIOR(chinese, macro,
    bindings = <&macro_press &kp SL &kp AL>, <&macro_release &kp SL &kp AL>;
)

ZMK_BEHAVIOR(lock_win, macro,
    bindings = <&macro_press &kp GL>, <&macro_tap &kp L>,  <&macro_release &kp GL >;
)

ZMK_BEHAVIOR(lock, macro,
    bindings = <&macro_press &kp GL>,<&macro_press &kp L> ,<&macro_release &kp GL>;
)

ZMK_BEHAVIOR(shift_gui, macro,
    bindings = <&macro_press &kp SL &kp GL>, <&macro_release &kp SL &kp GL>;
)

  //  bindings = <&kp SL &kp GL>;  -- not working, it ends up calling windows0
//    bindings = <&macro_press &kp SL>, <&macro_press  &kp GL>, <&macro_release SL>, <&macro_release GL>;
//    bindings = <&macro_press &kp SL &kp GL>; // terrible idea it will keep it pressed
//    move it layer? it will work for sure
//    bindings = <&macro_press &kp SL>,   &kp GL>, <&macro_release &kp SL>, <&macro_release &kp GL>;


ZMK_BEHAVIOR(alt_up, macro,
    bindings = <&macro_press  &kp AL>, <&macro_tap &kp UP>, <&macro_release &kp AL>;
)

ZMK_BEHAVIOR(alt_down, macro,
    bindings = <&macro_press  &kp AL>, <&macro_tap &kp DOWN>, <&macro_release &kp AL>;
)

ZMK_BEHAVIOR(alt_left, macro,
    bindings = <&macro_press  &kp AL>, <&macro_tap &kp LEFT>, <&macro_release &kp AL>;
)

ZMK_BEHAVIOR(alt_right, macro,
    bindings = <&macro_press  &kp AL>, <&macro_tap &kp RIGHT>, <&macro_release &kp AL>;
)



ZMK_BEHAVIOR(ctrl_up, macro,
    bindings = <&macro_press &kp CL>,  <&macro_tap &kp UP>, <&macro_release &kp CL>;
)

ZMK_BEHAVIOR(ctrl_down, macro,
    bindings = <&macro_press &kp CL>,  <&macro_tap &kp DOWN>, <&macro_release &kp CL>;
)

ZMK_BEHAVIOR(ctrl_left, macro,
    bindings = <&macro_press &kp CL>,  <&macro_tap &kp LEFT>, <&macro_release &kp CL>; 
)

ZMK_BEHAVIOR(ctrl_right, macro,
    bindings = <&macro_press &kp CL>,  <&macro_tap &kp RIGHT>, <&macro_release &kp CL>;
)



// numbers switching

ZMK_BEHAVIOR(ctrl_1, macro,
    bindings = <&macro_press &kp CL>,  <&macro_tap &kp N1>, <&macro_release &kp CL>;
)

ZMK_BEHAVIOR(ctrl_2, macro,
    bindings = <&macro_press &kp CL>,  <&macro_tap &kp N2>, <&macro_release &kp CL>;
)

ZMK_BEHAVIOR(ctrl_3, macro,
    bindings = <&macro_press &kp CL>,  <&macro_tap &kp N3>, <&macro_release &kp CL>;
)

ZMK_BEHAVIOR(ctrl_4, macro,
    bindings = <&macro_press &kp CL>,  <&macro_tap &kp N4>, <&macro_release &kp CL>;
)

ZMK_BEHAVIOR(ctrl_5, macro,
    bindings = <&macro_press &kp CL>,  <&macro_tap &kp N5>, <&macro_release &kp CL>;
)

ZMK_BEHAVIOR(ctrl_6, macro,
    bindings = <&macro_press &kp CL>,  <&macro_tap &kp N6>, <&macro_release &kp CL>;
)

ZMK_BEHAVIOR(ctrl_7, macro,
    bindings = <&macro_press &kp CL>,  <&macro_tap &kp N7>, <&macro_release &kp CL>;
)

ZMK_BEHAVIOR(ctrl_8, macro,
    bindings = <&macro_press &kp CL>,  <&macro_tap &kp N8>, <&macro_release &kp CL>;
)

ZMK_BEHAVIOR(ctrl_9, macro,
    bindings = <&macro_press &kp CL>,  <&macro_tap &kp N9>, <&macro_release &kp CL>;
)

ZMK_BEHAVIOR(ctrl_0, macro,
    bindings = <&macro_press &kp CL>,  <&macro_tap &kp N0>, <&macro_release &kp CL>;
)




ZMK_BEHAVIOR(gui_1, macro,
    bindings = <&macro_press &kp GL>,  <&macro_tap &kp N1>, <&macro_release &kp GL>;
)

ZMK_BEHAVIOR(gui_2, macro,
    bindings = <&macro_press &kp GL>,  <&macro_tap &kp N2>, <&macro_release &kp GL>;
)

ZMK_BEHAVIOR(gui_3, macro,
    bindings = <&macro_press &kp GL>,  <&macro_tap &kp N3>, <&macro_release &kp GL>;
)

ZMK_BEHAVIOR(gui_4, macro,
    bindings = <&macro_press &kp GL>,  <&macro_tap &kp N4>, <&macro_release &kp GL>;
)

ZMK_BEHAVIOR(gui_5, macro,
    bindings = <&macro_press &kp GL>,  <&macro_tap &kp N5>, <&macro_release &kp GL>;
)

ZMK_BEHAVIOR(gui_6, macro,
    bindings = <&macro_press &kp GL>,  <&macro_tap &kp N6>, <&macro_release &kp GL>;
)

ZMK_BEHAVIOR(gui_7, macro,
    bindings = <&macro_press &kp GL>,  <&macro_tap &kp N7>, <&macro_release &kp GL>;
)

ZMK_BEHAVIOR(gui_8, macro,
    bindings = <&macro_press &kp GL>,  <&macro_tap &kp N8>, <&macro_release &kp GL>;
)

ZMK_BEHAVIOR(gui_9, macro,
    bindings = <&macro_press &kp GL>,  <&macro_tap &kp N9>, <&macro_release &kp GL>;
)

ZMK_BEHAVIOR(gui_0, macro,
    bindings = <&macro_press &kp GL>,  <&macro_tap &kp N0>, <&macro_release &kp GL>;
)









ZMK_BEHAVIOR(clsl_1, macro,
    bindings = <&macro_press &kp CL>, <&macro_press &kp SL>,  <&macro_tap &kp N1>, <&macro_release &kp CL>, <&macro_release &kp SL>;
)

ZMK_BEHAVIOR(clsl_2, macro,
    bindings = <&macro_press &kp CL>, <&macro_press &kp SL>,  <&macro_tap &kp N2>, <&macro_release &kp CL>, <&macro_release &kp SL>;
)

ZMK_BEHAVIOR(clsl_3, macro,
    bindings = <&macro_press &kp CL>, <&macro_press &kp SL>,  <&macro_tap &kp N3>, <&macro_release &kp CL>, <&macro_release &kp SL>;
)

ZMK_BEHAVIOR(clsl_4, macro,
    bindings = <&macro_press &kp CL>, <&macro_press &kp SL>,  <&macro_tap &kp N4>, <&macro_release &kp CL>, <&macro_release &kp SL>;
)

ZMK_BEHAVIOR(clsl_5, macro,
    bindings = <&macro_press &kp CL>, <&macro_press &kp SL>,  <&macro_tap &kp N5>, <&macro_release &kp CL>, <&macro_release &kp SL>;
)

ZMK_BEHAVIOR(clsl_6, macro,
    bindings = <&macro_press &kp CL>, <&macro_press &kp SL>,  <&macro_tap &kp N6>, <&macro_release &kp CL>, <&macro_release &kp SL>;
)

ZMK_BEHAVIOR(clsl_7, macro,
    bindings = <&macro_press &kp CL>, <&macro_press &kp SL>,  <&macro_tap &kp N7>, <&macro_release &kp CL>, <&macro_release &kp SL>;
)

ZMK_BEHAVIOR(clsl_8, macro,
    bindings = <&macro_press &kp CL>, <&macro_press &kp SL>,  <&macro_tap &kp N8>, <&macro_release &kp CL>, <&macro_release &kp SL>;
)

ZMK_BEHAVIOR(clsl_9, macro,
    bindings = <&macro_press &kp CL>, <&macro_press &kp SL>,  <&macro_tap &kp N9>, <&macro_release &kp CL>, <&macro_release &kp SL>;
)

ZMK_BEHAVIOR(clsl_0, macro,
    bindings = <&macro_press &kp CL>, <&macro_press &kp SL>,  <&macro_tap &kp N0>, <&macro_release &kp CL>, <&macro_release &kp SL>;
)



ZMK_BEHAVIOR(alt_1, macro,
    bindings = <&macro_press &kp AL>,  <&macro_tap &kp N1>, <&macro_release &kp AL>;
)

ZMK_BEHAVIOR(alt_2, macro,
    bindings = <&macro_press &kp AL>,  <&macro_tap &kp N2>, <&macro_release &kp AL>;
)

ZMK_BEHAVIOR(alt_3, macro,
    bindings = <&macro_press &kp AL>,  <&macro_tap &kp N3>, <&macro_release &kp AL>;
)

ZMK_BEHAVIOR(alt_4, macro,
    bindings = <&macro_press &kp AL>,  <&macro_tap &kp N4>, <&macro_release &kp AL>;
)

ZMK_BEHAVIOR(alt_5, macro,
    bindings = <&macro_press &kp AL>,  <&macro_tap &kp N5>, <&macro_release &kp AL>;
)

ZMK_BEHAVIOR(alt_6, macro,
    bindings = <&macro_press &kp AL>,  <&macro_tap &kp N6>, <&macro_release &kp AL>;
)

ZMK_BEHAVIOR(alt_7, macro,
    bindings = <&macro_press &kp AL>,  <&macro_tap &kp N7>, <&macro_release &kp AL>;
)

ZMK_BEHAVIOR(alt_8, macro,
    bindings = <&macro_press &kp AL>,  <&macro_tap &kp N8>, <&macro_release &kp AL>;
)

ZMK_BEHAVIOR(alt_9, macro,
    bindings = <&macro_press &kp AL>,  <&macro_tap &kp N9>, <&macro_release &kp AL>;
)

ZMK_BEHAVIOR(alt_0, macro,
    bindings = <&macro_press &kp AL>,  <&macro_tap &kp N0>, <&macro_release &kp AL>;
)






ZMK_BEHAVIOR(shift_win_LEFT, macro,
    bindings = <&macro_press &kp GL>, <&macro_press &kp SL>,  <&macro_tap &kp LEFT>, <&macro_release &kp GL>, <&macro_release &kp SL>;
)

ZMK_BEHAVIOR(shift_win_RIGHT, macro,
    bindings = <&macro_press &kp GL>, <&macro_press &kp SL>,  <&macro_tap &kp RIGHT>, <&macro_release &kp GL>, <&macro_release &kp SL>;
)

ZMK_BEHAVIOR(shift_win_UP, macro,
    bindings = <&macro_press &kp GL>, <&macro_press &kp SL>,  <&macro_tap &kp UP>, <&macro_release &kp GL>, <&macro_release &kp SL>;
)

ZMK_BEHAVIOR(shift_win_DOWN, macro,
    bindings = <&macro_press &kp GL>, <&macro_press &kp SL>,  <&macro_tap &kp DOWN>, <&macro_release &kp GL>, <&macro_release &kp SL>;
)


ZMK_BEHAVIOR(win_LEFT, macro,
    bindings = <&macro_press &kp GL>,  <&macro_tap &kp LEFT>, <&macro_release &kp GL>;
)

ZMK_BEHAVIOR(win_RIGHT, macro,
    bindings = <&macro_press &kp GL>,  <&macro_tap &kp RIGHT>, <&macro_release &kp GL>;
)

ZMK_BEHAVIOR(win_UP, macro,
    bindings = <&macro_press &kp GL>,  <&macro_tap &kp UP>, <&macro_release &kp GL>;
)

ZMK_BEHAVIOR(win_DOWN, macro,
    bindings = <&macro_press &kp GL>,  <&macro_tap &kp DOWN>, <&macro_release &kp GL>;
)

