#include <behaviors.dtsi>
#include <dt-bindings/zmk/keys.h>
#include "../zmk-nodefree-config/helper.h"
#include "../zmk-nodefree-config/keypos_def/keypos_36keys.h"

#pragma once

#undef CONFIG_ZMK_MACRO_QWEAULT_WAIT_MS
#define CONFIG_ZMK_MACRO_QWEAULT_WAIT_MS 30

#undef CONFIG_ZMK_MACRO_QWEAULT_TAP_MS
#define CONFIG_ZMK_MACRO_QWEAULT_TAP_MS 40


// ` directly
ZMK_BEHAVIOR(GRA, macro, bindings =
    <&macro_press &kp RALT>,
    <&macro_tap &kp LBKT &kp LBKT>,
    <&macro_release &kp RALT>;
)

// ^ directly
ZMK_BEHAVIOR(CAR, macro, bindings =
    <&macro_tap &kp LBKT &kp SPACE>;
)

// ¨ directly
ZMK_BEHAVIOR(TREMA, macro_one_param, bindings =
    <&macro_tap &kp LS(LBKT) &kp SPACE>,
    <&macro_param_1to1>,
    <&to MACRO_PLACEHOLDER>;
)


